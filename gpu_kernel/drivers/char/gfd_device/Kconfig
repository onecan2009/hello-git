## gpu_kernel/drivers/char/gfd_device/Kconfig
```kconfig
#
# TMP device configuration
#

menuconfig GFD_HARDWARE_MODULES
	tristate "GFD Hardware Support"
	default y
	---help---
	  add by terry 2015-12-14

if GFD_HARDWARE_MODULES

config RK3288_LARK_UPS
	tristate "lark_ups Support"
	default y
	---help---
	  If you have a TPM security chip that is compliant with the
	  TCG TIS 1.2 TPM specification say Yes and it will be accessible
	  from within Linux.  To compile this driver as a module, choose
	  M here; the module will be called tpm_tis.

	  
endif # TMP122
```

## gpu_kernel/drivers/hello/Kconfig
```kconfig
#
# led test  device configuration
#

menuconfig GFD_HELLO_LED_TEST
	tristate "gfd hello led test"
	default y
	---help---
	  add by terry 2015-12-14

if GFD_HELLO_LED_TEST

config RK3288_LARK_HELLO
	tristate "lark hello test"
	default y
	---help---
	  LED test

	  
endif # hello test
```
